## meta-deviceManagement/conf/layer.conf
```bitbake
# We have a conf and classes directory, add to BBPATH
BBPATH .= ":${LAYERDIR}"

# We have recipes-* directories, add to BBFILES
BBFILES += "${LAYERDIR}/recipes-*/*/*.bb \
            ${LAYERDIR}/recipes-*/*/*.bbappend"

BBFILE_COLLECTIONS += "meta-deviceManagement"
BBFILE_PATTERN_meta-deviceManagement = "^${LAYERDIR}/"
BBFILE_PRIORITY_meta-deviceManagement = "6"

LAYERDEPENDS_meta-deviceManagement = "core"
LAYERSERIES_COMPAT_meta-deviceManagement = "kirkstone"
```
